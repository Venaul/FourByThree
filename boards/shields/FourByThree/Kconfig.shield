## boards/shields/FourByThree/Kconfig.shield
```kconfig
# Copyright (c) 2020 The ZMK Contributors
# SPDX-License-Identifier: MIT

config FourByThree
    def_bool $(shields_list_contains,FourByThree)
```
